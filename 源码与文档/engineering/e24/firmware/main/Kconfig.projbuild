## 源码与文档/engineering/e24/firmware/main/Kconfig.projbuild
```kconfig
menu "E24 应用"
choice E24_PROFILE
    prompt "构建档位"
    default E24_PROFILE_LINK
config E24_PROFILE_BRINGUP
    bool "点亮：只用 GPIO，日志走 USB-Serial-JTAG"
config E24_PROFILE_LINK
    bool "联调：TinyUSB（HID 鼠标/控制/配置 + CDC 日志）+ BMI270 指向"
endchoice
config E24_MIC_POC_OPEN
    bool "POC：主机打开麦克风流就放行，不用按 V（放宽规格 AUD 02，只烧台架板）"
    depends on E24_PROFILE_LINK
    default n
    help
        把板子当普通 USB 麦克风用，便于闭环测试录音效果。主机关流时闸门立刻关，
        设备名改成 AI KEY Mic POC 以便识别。不得用于量产或交付给用户的固件。
config E24_IMU_ODR_HZ
    int "BMI270 输出频率 (Hz)"
    default 200
    range 100 800
endmenu
```

## 源码与文档/engineering/e24/firmware/sdkconfig.defaults
```kconfig
# E24 主板：ESP32-S3-WROOM-1-N8R8（8MB Quad Flash + 8MB Octal PSRAM）
CONFIG_IDF_TARGET="esp32s3"
CONFIG_ESPTOOLPY_FLASHSIZE_8MB=y
CONFIG_ESPTOOLPY_FLASHMODE_DIO=y
CONFIG_SPIRAM=y
CONFIG_SPIRAM_MODE_OCT=y
CONFIG_SPIRAM_SPEED_80M=y
CONFIG_SPIRAM_USE_MALLOC=y
CONFIG_SPIRAM_IGNORE_NOTFOUND=n

# 分区：双 OTA
CONFIG_PARTITION_TABLE_CUSTOM=y
CONFIG_PARTITION_TABLE_CUSTOM_FILENAME="partitions.csv"
CONFIG_ESP_COREDUMP_ENABLE_TO_FLASH=y

# 控制台按档位设置：sdkconfig.bringup.defaults（USB-Serial-JTAG）/ sdkconfig.link.defaults（TinyUSB CDC）

# TinyUSB：HID 1 个 + CDC 1 个（联调档使用；点亮档编译但不初始化）
CONFIG_TINYUSB_HID_COUNT=1
CONFIG_TINYUSB_CDC_ENABLED=y
CONFIG_TINYUSB_CDC_COUNT=1
CONFIG_TINYUSB_MSC_ENABLED=n
CONFIG_LOG_DEFAULT_LEVEL_INFO=y

CONFIG_FREERTOS_HZ=1000
CONFIG_ESP_MAIN_TASK_STACK_SIZE=8192
```

## 源码与文档/engineering/rev-a/firmware/sdkconfig.defaults
```kconfig
CONFIG_IDF_TARGET="esp32s3"
CONFIG_ESPTOOLPY_FLASHSIZE_16MB=y
CONFIG_ESPTOOLPY_FLASHMODE_DIO=y
CONFIG_SPIRAM=y
CONFIG_SPIRAM_MODE_OCT=y
CONFIG_SPIRAM_SPEED_80M=y
CONFIG_SPIRAM_USE_MALLOC=y
CONFIG_SPIRAM_IGNORE_NOTFOUND=n
CONFIG_FREERTOS_HZ=1000
CONFIG_ESP_MAIN_TASK_STACK_SIZE=8192
CONFIG_ESP_CONSOLE_UART_DEFAULT=y
CONFIG_LOG_DEFAULT_LEVEL_WARN=y
CONFIG_TINYUSB_HID_COUNT=1
CONFIG_TINYUSB_CDC_ENABLED=n
CONFIG_TINYUSB_MSC_ENABLED=n
CONFIG_PARTITION_TABLE_CUSTOM=y
CONFIG_PARTITION_TABLE_CUSTOM_FILENAME="partitions.csv"
CONFIG_BT_ENABLED=y
# CONFIG_BT_BLUEDROID_ENABLED is not set
CONFIG_BT_NIMBLE_ENABLED=y
CONFIG_BT_NIMBLE_NVS_PERSIST=y
CONFIG_BT_NIMBLE_MAX_CONNECTIONS=1
CONFIG_BT_NIMBLE_MAX_BONDS=1
CONFIG_BT_NIMBLE_ATT_PREFERRED_MTU=64

CONFIG_ESP_TLS_PSK_VERIFICATION=y
```
